## boards/arm/nucleo_f446re_pokibot/nucleo_f446re_pokibot_defconfig
```kconfig
# SPDX-License-Identifier: Apache-2.0

CONFIG_SOC_SERIES_STM32F4X=y
CONFIG_SOC_STM32F446XX=y
# 180MHz system clock (because I am speed)
CONFIG_SYS_CLOCK_HW_CYCLES_PER_SEC=180000000

# Enable MPU
CONFIG_ARM_MPU=y

# Enable HW stack protection
CONFIG_HW_STACK_PROTECTION=y

CONFIG_SERIAL=y

# console
CONFIG_CONSOLE=y
CONFIG_UART_CONSOLE=y

# enable pinmux
CONFIG_PINMUX=y

# enable GPIO
CONFIG_GPIO=y

# enable pin controller
CONFIG_PINCTRL=y

# clock configuration
CONFIG_CLOCK_CONTROL=y
```
